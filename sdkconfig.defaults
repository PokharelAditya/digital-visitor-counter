## sdkconfig.defaults
```kconfig
# Use custom partition table
CONFIG_PARTITION_TABLE_CUSTOM=y
CONFIG_PARTITION_TABLE_CUSTOM_FILENAME="partitions.csv"

# Enable SPIFFS
CONFIG_SPIFFS_MAX_PARTITIONS=1

# Enable TLS certificate bundle for HTTPS (Firebase)
CONFIG_MBEDTLS_CERTIFICATE_BUNDLE=y
CONFIG_MBEDTLS_CERTIFICATE_BUNDLE_DEFAULT_FULL=y

# Allow larger HTTP response buffers
CONFIG_ESP_HTTP_CLIENT_ENABLE_HTTPS=y

# UART console on UART0
CONFIG_ESP_CONSOLE_UART_NUM=0
CONFIG_ESP_CONSOLE_UART_BAUDRATE=115200

# FreeRTOS tick rate
CONFIG_FREERTOS_HZ=1000
```
